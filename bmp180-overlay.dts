/dts-v1/;
/plugin/;

/ {
    compatible = "brcm,bcm2835";

    fragment@0 {
        target = <&i2c1>;
        __overlay__ {
            bmp180@77 {
                compatible = "bosch,bmp180";
                reg = <0x77>; // I2C address
                status = "okay";
            };
        };
    };
};
